## linux-kernel/arch/riscv/Kconfig.socs
```kconfig
menu "SoC selection"

config SOC_SIFIVE
	bool "SiFive SoCs"
	select SERIAL_SIFIVE if TTY
	select SERIAL_SIFIVE_CONSOLE if TTY
	select CLK_SIFIVE
	select CLK_SIFIVE_FU540_PRCI
	select SIFIVE_PLIC
	help
	  This enables support for SiFive SoC platform hardware.

config SOC_KENDRYTE
	bool "Kendryte K210 SoC"
	depends on !MMU
	select BUILTIN_DTB
	select SERIAL_SIFIVE if TTY
	select SERIAL_SIFIVE_CONSOLE if TTY
	select SIFIVE_PLIC
	help
	  This enables support for Kendryte K210 SoC hardware.

endmenu
```
